/*
 * OPTIONAL reference NVS layout for STM32F446ZE 512 KiB internal flash.
 * Uses the final two 128 KiB flash sectors (0x40000..0x7FFFF).
 * Enable only after confirming the application fits below 0x40000 and after
 * reviewing the final linker/bootloader memory map.
 */
&flash0 {
    partitions {
        compatible = "fixed-partitions";
        #address-cells = <1>;
        #size-cells = <1>;

        storage_partition: partition@40000 {
            label = "bms-storage";
            reg = <0x00040000 0x00040000>;
        };
    };
};
